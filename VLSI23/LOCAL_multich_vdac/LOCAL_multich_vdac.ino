/*

Stimuli Generator v1
SPI interface for multi-channel DACs to generate analog signals as input to the INTUITIVE testchip
AD5592R 8-ch 12-bit DACs

tlength=0.4ms
fsample=10kHz

samplelength=tlength*fsample=4000
total_samplelength = 16 channels*4000 = 64000

SCLK, MISO, MOSI of 2 boards shorted through jumper wires and soldered headers
desolder jumper for EXT VREF on JP1
 - save data by using 8 of 12 bits stored in 'byte' array
 - fullscale = 5*255/4096 = 311.279 mV
 - LSB = 1.22 mV


inspired by code in: https://electronics-fun.com/arduino-sine-wave-generator/
*/

#include <SPI.h>
#include <digitalWriteFast.h>
//#define DATALEN 4032
#define DATALEN 1152

const int SYNCb_DAC1 = 49; // change to actual
const int SYNCb_DAC2 = 48;


unsigned long time0=0;
//const PROGMEM uint8_t DATABANK[][2] = {{1,1},{2,2}}; 
const PROGMEM uint8_t DATABANK_TT[][DATALEN] = 
{128,128,128,128,128,128,129,129,129,129,129,130,130,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128
};

const PROGMEM uint8_t DATABANK_CH0[8][DATALEN] = {{0,33,63,90,112,131,146,157,164,169,171,170,168,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73
},{0,35,67,94,118,137,152,163,170,173,174,173,170,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70
},{0,36,68,95,118,136,149,159,164,167,167,166,164,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65
},{0,36,67,93,113,129,140,147,150,152,151,151,150,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57
},{0,32,61,86,109,127,142,153,161,167,170,171,170,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74
},{0,34,64,91,114,132,147,158,165,169,170,169,167,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73
},{0,35,66,93,115,133,147,157,163,166,166,165,163,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72
},{0,36,67,94,115,131,143,151,155,157,157,156,154,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67
}};

const PROGMEM uint8_t DATABANK_CH1[8][DATALEN]= {{0,31,59,84,105,123,137,149,157,162,166,168,169,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76
},{0,34,63,90,112,130,143,153,160,164,165,164,162,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75
},{0,35,66,93,115,133,146,156,161,164,164,163,160,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75
},{0,36,68,95,117,134,147,156,161,164,164,163,160,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74
},{0,31,59,83,103,120,134,145,153,158,162,165,166,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76
},{0,34,64,90,112,129,143,152,159,162,163,162,161,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76
},{0,36,67,94,116,134,147,156,161,163,163,161,158,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77
},{0,36,68,95,117,135,148,157,162,164,163,161,159,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76
}}; 

void setup() {

  // initialize SPI:
  SPI.begin();   

  // initialize UART
  // maximum baudrate for Arduino IDE
  Serial.begin(2000000);
  Serial.flush();   
  Serial.println("\nSPI Interface for Stimuli Generator");  

  // rated for 20ns -> 50MHz
  SPISettings settingsA(50000000, MSBFIRST, SPI_MODE2);  
  SPI.beginTransaction(settingsA);      

  dac_setup_all(0);
  dac_setup_all(1);
  
}

void dac_setup_all(int WHICH_DAC) {

 

  if (WHICH_DAC==0) {

    // SW_RESET
    pinMode(SYNCb_DAC1, OUTPUT); // The CS_Pin should remain in a high impedance state (INPUT) when it is not in use.    
    digitalWrite(SYNCb_DAC1, LOW); // Activate the CS line (CS is active LOW)

    SPI.transfer(0x7D); 
    SPI.transfer(0xAC);     

    pinMode(SYNCb_DAC1, INPUT); // Set CS_Pin to high impedance to allow pull-up to reset CS to inactive.
    digitalWrite(SYNCb_DAC1, HIGH); // Enable internal pull-up     

    //SPI.endTransaction();
    Serial.println("Chip1 reset");  

    // DAC CONFIG
    // configure all channels as DACs
    pinMode(SYNCb_DAC1, OUTPUT); // The CS_Pin should remain in a high impedance state (INPUT) when it is not in use.    
    digitalWrite(SYNCb_DAC1, LOW); // Activate the CS line (CS is active LOW)

    SPI.transfer(0x28); 
    SPI.transfer(0xFF);     

    pinMode(SYNCb_DAC1, INPUT); // Set CS_Pin to high impedance to allow pull-up to reset CS to inactive.
    digitalWrite(SYNCb_DAC1, HIGH); // Enable internal pull-up     

    //SPI.endTransaction();
    Serial.println("Chip1 configured as DACs");  

    // POWER DOWN / REFERENCE CTRL REGISTER
    // enable internal vref only, do not power down
    pinMode(SYNCb_DAC1, OUTPUT); // The CS_Pin should remain in a high impedance state (INPUT) when it is not in use.    
    digitalWrite(SYNCb_DAC1, LOW); // Activate the CS line (CS is active LOW)

    SPI.transfer(0x5A); // D9=1 
    SPI.transfer(0x00); // normal mode     

    pinMode(SYNCb_DAC1, INPUT); // Set CS_Pin to high impedance to allow pull-up to reset CS to inactive.
    digitalWrite(SYNCb_DAC1, HIGH); // Enable internal pull-up     

    //SPI.endTransaction();
    Serial.println("Chip1 internal VREF enabled");  
  } else if (WHICH_DAC==1) {

      // SW_RESET
      pinMode(SYNCb_DAC2, OUTPUT); // The CS_Pin should remain in a high impedance state (INPUT) when it is not in use.    
      digitalWrite(SYNCb_DAC2, LOW); // Activate the CS line (CS is active LOW)

      SPI.transfer(0x7D); 
      SPI.transfer(0xAC);     

      pinMode(SYNCb_DAC2, INPUT); // Set CS_Pin to high impedance to allow pull-up to reset CS to inactive.
      digitalWrite(SYNCb_DAC2, HIGH); // Enable internal pull-up     

      //SPI.endTransaction();
      Serial.println("Chip2 reset");  

      // DAC CONFIG
      // configure all channels as DACs
      pinMode(SYNCb_DAC2, OUTPUT); // The CS_Pin should remain in a high impedance state (INPUT) when it is not in use.    
      digitalWrite(SYNCb_DAC2, LOW); // Activate the CS line (CS is active LOW)

      SPI.transfer(0x28); 
      SPI.transfer(0xFF);     

      pinMode(SYNCb_DAC2, INPUT); // Set CS_Pin to high impedance to allow pull-up to reset CS to inactive.
      digitalWrite(SYNCb_DAC2, HIGH); // Enable internal pull-up     

      //SPI.endTransaction();
      Serial.println("Chip2 configured as DACs");  

      // POWER DOWN / REFERENCE CTRL REGISTER
      // enable internal vref only, do not power down
      pinMode(SYNCb_DAC2, OUTPUT); // The CS_Pin should remain in a high impedance state (INPUT) when it is not in use.    
      digitalWrite(SYNCb_DAC2, LOW); // Activate the CS line (CS is active LOW)

      SPI.transfer(0x5A); // D9=1 
      SPI.transfer(0x00); // normal mode     

      pinMode(SYNCb_DAC2, INPUT); // Set CS_Pin to high impedance to allow pull-up to reset CS to inactive.
      digitalWrite(SYNCb_DAC2, HIGH); // Enable internal pull-up     

      //SPI.endTransaction();
      Serial.println("Chip2 internal VREF enabled");      
  }
}  

void dac_write(int WHICH_DAC, int CH, float VAL) {

  // Assumes: SPI.begin and end happens outside this function
  uint8_t channel;
  uint16_t dacval;
    
  dacval = round(4096*VAL/2.5);
  // Serial.print("dacval preshift: ");  
  // Serial.println(dacval,BIN);  
  //dacval = round(4096*VAL/5);
  channel = (CH << 4  & 0x70) | 0x80 | (dacval >> 8 & 0x0F);

  // Serial.print("channel: ");
  // Serial.println(channel,BIN);
  // Serial.print("dacval: ");  
  // Serial.println(dacval,BIN);

  // DAC_WR (DAC write register)
  if (WHICH_DAC==0) {

    pinMode(SYNCb_DAC1, OUTPUT); // The CS_Pin should remain in a high impedance state (INPUT) when it is not in use.    
    digitalWriteFast(SYNCb_DAC1, LOW); // Activate the CS line (CS is active LOW)

    SPI.transfer(channel); 
    SPI.transfer(dacval & 0xFF);     

    //pinMode(SYNCb_DAC1, INPUT); // Set CS_Pin to high impedance to allow pull-up to reset CS to inactive.
    digitalWriteFast(SYNCb_DAC1, HIGH); // Enable internal pull-up    

  } else if (WHICH_DAC==1) {

    pinMode(SYNCb_DAC2, OUTPUT); // The CS_Pin should remain in a high impedance state (INPUT) when it is not in use.    
    digitalWriteFast(SYNCb_DAC2, LOW); // Activate the CS line (CS is active LOW)

    SPI.transfer(channel); 
    SPI.transfer(dacval & 0xFF);     

    //pinMode(SYNCb_DAC2, INPUT); // Set CS_Pin to high impedance to allow pull-up to reset CS to inactive.
    digitalWriteFast(SYNCb_DAC2, HIGH); // Enable internal pull-up     
  }    
}

void sineout_inf (float amp, float fin, float ofs) {

  float wave;
  float t;
  //const float tlength = 0.4; // from MATLAB sims before
  float tlength = 1/fin; // 1 cycle of fin
  const float fs = 10000; // from MATLAB sims before
  //float n = round(tlength*fin*fs);
  float n = round(tlength*fs);
  //float tlength = 1/fin;
  //float dt;

  int chip;
  int ch;

  int i;

  //dt = 1/fs;

  while(1) {

    //for(t=0;t<tlength-dt;t=t+dt) {
    for(i=0; i < n; i++) {  
      t = (float) i / (fs/fin);
      wave = (amp * sin(2*3.14*t)) + ofs; // accepts radians
      //Serial.println(wave, DEC);      

      //time0 = micros();
      // assumes delay in all this << one oversampling period
      for(chip=0;chip<2;chip++) {
        for(ch=0;ch<8;ch++) {
          dac_write(chip, ch, wave);
        }
      }

      // dac_write(0, 0, wave);      
      // dac_write(0, 1, wave); 
      // dac_write(0, 2, wave);      
      // dac_write(0, 3, wave); 
      // dac_write(0, 4, wave);      
      // dac_write(0, 5, wave); 
      // dac_write(0, 6, wave);      
      // dac_write(0, 7, wave);      
      // dac_write(1, 0, wave);      
      // dac_write(1, 1, wave); 
      // dac_write(1, 2, wave);      
      // dac_write(1, 3, wave); 
      // dac_write(1, 4, wave);      
      // dac_write(1, 5, wave); 
      // dac_write(1, 6, wave);      
      // dac_write(1, 7, wave);          
                  
      // //Serial.print("Elapsed time to program all DACs: ");
      //Serial.println(micros() - time0, DEC);

      //delayMicroseconds(1000000/fs/10);

    }
  }
}



void read_data_bank(float vpp, float ofs) {
  float incomingByte;  
  float data; // needs to be float so computation of data_dac is not rounded off
  float data_dac;

  int chip;
  int ch;

  int i; 
  int n; 

  const float fs = 10000; // from MATLAB sims before  
  //const float vpp = 0.005;
  //const float ofs = 0.256;


  while(1) {


    //ch=1;
    // assumes delay in all this << one oversampling period
    for(n=0;n<DATALEN;n++) {     
      //time0 = micros(); 
      for(ch=0;ch<8;ch++) {
      //for(ch=1;ch<2;ch++) {  
        data = pgm_read_byte(&(DATABANK_CH0[ch][n]));
        //data = pgm_read_byte(&(DATABANK_TT[0][n]));         
        //data_dac = pgm_read_float(DATABANK_FL+n);  
        //data =  pgm_read_byte(DATABANK_CH0+n);    
        //Serial.println(data);
        data_dac =  ofs + vpp*((data - 127) / 256);
        //data_dac =  ofs + vpp*(((int)data - 127) << 8);
        //Serial.println(data_dac,6);
        dac_write(0, ch, data_dac);
        // Serial.println(ch,DEC);
        // Serial.println(data,DEC);
        // Serial.println(data_dac,8);
      }   

      for(ch=0;ch<8;ch++) {
        data = pgm_read_byte(&(DATABANK_CH1[ch][n]));        
        //data = pgm_read_byte(&(DATABANK_TT[0][n])); 
        data_dac = ofs + vpp*((data - 127) / 256);        
        dac_write(1, ch, data_dac);
      }        
      
      //delayMicroseconds(1000000/fs); 
      //Serial.print("Elapsed time to program all DACs: ");
      //Serial.println(micros() - time0, DEC);
    }     
    




      
  }  
}




void loop() {

  // 10mVpp, 100Hz, 250mV offset
  //sineout_inf(0.18,100,0.25);
  //dac_write(0, 0, 2.4);  
  read_data_bank(0.018,0.25);
  //read_data_bank_ch0(0.018,0.25);

  
}

